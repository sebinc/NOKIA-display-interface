#ifndef LCD1_H
#define LCD1_H

/////////////////////////////////////////////////////
// SSPCON=0x00;       clock is active low          //
/////////////////////////////////////////////////////

				
#include "includes.h"


////////////////////////////////////////////////////////////////////////////
///////////////DFINITIONS///////////////////////////////////////////////////
////////////////////////////////////////////////////////////////////////////
#define s_clk RC3
#define s_dat RC5
#define cs RB1
#define dc RB0
#define res RB2



//////////////////////////////////////////////////////////////////
//////////Function  declarations//////////////////////////////////
//////////////////////////////////////////////////////////////////



void nokia_spi(unsigned char data);
void lcd_init(void);
void lcd_data(unsigned char);
void lcd_cmd(unsigned char);
void lcd_reset(void);
void lcd_gotoxy(char x,char y);
void lcd_chara(unsigned char);
void lcd_cls(void);
void delay(unsigned char x);
void lcd_str(const char *str);

//////////////////////////////////////////////////////////////////
////////////////  LOOK UP TABLE FOR FONT /////////////////////////
//////////////////////////////////////////////////////////////////

static const unsigned char Lookup [][5] =
{
    { 0x00, 0x00, 0x00, 0x00, 0x00 },  // space
    { 0x00, 0x00, 0x2f, 0x00, 0x00 },   // !
    { 0x00, 0x07, 0x00, 0x07, 0x00 },   // "
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    { 0x44, 0x64, 0x54, 0x4C, 0x44 }    // z
};

/// ///////lcd initialization/////////////////////////////
//////////////////////////////////////////////////////////
//////////////////////////////////////////////////////////

void lcd_init(void)
{
	lcd_reset();
	lcd_cmd(0xA6);  //lcd normal mode
	lcd_cmd(0xA2);//bias 1 over
	lcd_cmd(0xA1);//adc reverse   ,,,A0 for display in reverse order
	lcd_cmd(0xC0);//comm normal
	lcd_cmd(0x24);    //24
	lcd_cmd(0x81);    //81
	lcd_cmd(0x2E);    ///power control
	lcd_cmd(0x2F);
	lcd_cmd(0xE3);//lcd nop
	lcd_cmd(0x2f);
	lcd_cmd(0xAF);//lcd on
	lcd_cmd(0xA5);//lcd all on
	delay(50);
	lcd_cmd(0xAE);//lcd off
	lcd_cls();
	delay(10);
	lcd_cmd(0xAF);//lcd all off
	delay(30);
	lcd_cmd(0xA4);
	return;
}


/// ///////lcd data//////////////


void lcd_data(unsigned char x)
{
	dc=1;
	cs=0;
	
//	spi_sendbyte(l);
	nokia_spi(x);
	cs=1;
}



/// ///////lcd data////////////////////////////


void lcd_cmd(unsigned char c)
{
	dc=0;
	cs=0;
//	spi_sendbyte(c);
	nokia_spi(c);
	cs=1;
}	
		

/// ///////lcd reset//////////////

void lcd_reset(void)
{
	dc=1;
	cs=1;
	delay(50);
	cs=0;

	delay(100);
	cs=1;
	
	delay(250);
}	

//////////////////////////////////////////////////////////////

void lcd_gotoxy(char x_pos,char y_pos)
{
	unsigned char col;
	col=0x12+ y_pos*6;          //font require 5 row
	lcd_cmd(0xB0+x_pos);          //colum
	unsigned char tmp;
	tmp=col>>4;
	lcd_cmd(0x11|tmp);
	lcd_cmd(0x0f&col);     //LSB
}	
	
	
//////////////////////////////////////////////////////////////


void lcd_chara(unsigned char x)
{
	if(x<0x20) return;
	if(x>0x7f) return;

	    unsigned char i,char_data,char_pos;
    	char_pos=x-0x20;
	
     	for(i=0;i<5;i++) // 5 bytes
      	{
	    	
	    	char_data=Lookup[x-32][i];
		
	    	lcd_data(char_data);   ///use ~char_data for white character in black screen
    	}
    	
		lcd_data(0x00);   //blank data b/w characters
 
}   	
	
	
	//////////////////////////////////////////////////////////////
	
	void delay(unsigned char x)
	{
		unsigned char i=x/10;
		for (char j=0;j<i;j++)
		__delay_ms(10);
	}	
		
	
/////////////////////////////////////////////////////////////////////

void lcd_cls()
{
	unsigned char page;
	for(page=0;page<9;page++)        // 9 pages
	{
		lcd_cmd(0xB0+page);
		lcd_cmd(0x11);
		lcd_cmd(0x01);
		for(unsigned char x=96;x>0;x--)      //make all 96 pixels to zero
		lcd_data(0x00);
	}
}			
	
	
////////////////////////////////////////////////////////////////

void lcd_str(const char *str) 
{
	unsigned char k=0;
while (str[k]!=0)
{
  lcd_chara(str[k]);
   k++;
}
}




/////////////////////////////////////////////////////////////////
/////////////////////////////////////////////////////////////////
void nokia_spi(unsigned char data )			// serial write data or command Software SPI
{
for (char c=8;c>0;c--)
	 {
		s_clk=0;
		
		if ((data&0x80)==0)
		s_dat=0;
		else 
		s_dat=1;
		
		
		s_clk=1;
		data=data<<1;
	  }
}






























#endif